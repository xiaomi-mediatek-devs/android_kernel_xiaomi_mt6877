## drivers/misc/mediatek/adsp/Kconfig
```kconfig
config MTK_AUDIODSP_SUPPORT
	bool "Specifiy If Platform Support Audio dsp"
	default n
	select MTK_AUDIO_IPI
	help
	  AUDIO_DSP is a MediaTek in-house DSP which can do
	  different audio process.
	  Set Y to enable this feature.
	  If unsure,
	  Set N to stay with legancy feature.

config MTK_AUDIODSP_LEGACY
	bool "Compat with legacy audio firmware/blobs"
	default n
	depends on MTK_AUDIODSP_SUPPORT
	help
	  Enable this option if your device uses older audio firmware/blobs.

	  If unsure, say N.
```
